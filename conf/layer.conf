## conf/layer.conf
```bitbake
BBPATH .= ":${LAYERDIR}"
BBFILES += "\
    ${LAYERDIR}/recipes-*/*/*.bb \
    ${LAYERDIR}/recipes-*/*/*.bbappend"

BBFILE_COLLECTIONS += "meta-doom"
BBFILE_PATTERN_meta-doom = "^${LAYERDIR}/"
BBFILE_PRIORITY_meta-doom = "6"

LAYERDEPENDS_meta-doom = "core"
LAYERSERIES_COMPAT_meta-doom = "scarthgap"
```
